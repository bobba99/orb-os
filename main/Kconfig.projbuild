## main/Kconfig.projbuild
```kconfig
menu "The Orb OS"

    config ORB_BRINGUP_PAGE
        bool "Boot to the display and knob bring-up page instead of the apps"
        default n
        help
            Shows a plain test page that exercises only the panel and the knob: a detent
            count, an arc that follows the knob, presses, rock timing and colour swatches.
            For the first flash of a new display or knob driver, before the apps are trusted
            on it. Opens no SD card and no NVS.

    config ORB_WIFI_COUNTRY
        string "WiFi country code"
        default "01"
        help
            Which channels the radio may scan and use. "01" is ESP-IDF's world-safe set,
            channels 1 to 11. Most of Europe, Norway included, also allows 12 and 13, and a
            router on one of those is invisible under "01"; set "NO", "GB", "DE"... for those.

    config ORB_WIFI_SETUP_AFTER_S
        int "Open The Orb Setup after this long without a network (seconds)"
        default 300
        range 30 3600
        help
            With saved networks, none of which has answered for this long, the Orb opens its
            setup access point ("The Orb Setup") and keeps trying its saved networks while it is
            up. With no saved network at all it opens at once. The station side is never turned
            off for it, which is the lesson of the Arduino firmware's portal.

    config ORB_DEV_WIFI_SSID
        string "Development network to join instead of the stored one"
        default ""
        help
            For working on the firmware away from the network the Orb has saved. When set,
            this network is joined instead, in RAM only: the driver's saved network is never
            replaced, so the Orb goes back to it on the next build without this set. Put it in
            sdkconfig.dev (git-ignored), never in sdkconfig.defaults.

    config ORB_DEV_WIFI_PASS
        string "Password for the development network (empty for an open network)"
        default ""

    config ORB_DEV_THEME_URL
        string "Download themes from this address at boot (development only)"
        default ""
        help
            Where `python3 tools/theme_tool.py serve <folders>` is running, e.g.
            "http://192.168.10.20:8000". Once WiFi is up the Orb copies every theme listed
            there into /themes/ on the card (main/dev_themes.cpp), then they can be chosen in
            Settings > Theme. Plain HTTP on the local network: set it only in the git-ignored
            sdkconfig.dev, never in sdkconfig.defaults.

endmenu
```
